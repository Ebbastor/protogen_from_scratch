
/*********
Image to C link:
https://lvgl.io/tools/imageconverter

you need to install the following moudules 
Adafruit_GFX.h
include "PxMatrix.h
*********/

#include <Arduino.h>
#include "Adafruit_GFX.h"
#include "PxMatrix.h"



#define P_LAT 22                  //Connect your matrix to these pins !!!!!
#define P_A 19
#define P_B 23
#define P_C 18
#define P_D 5
#define P_E 15
#define P_OE 2


const uint8_t static PROGMEM owo[] = {
 0x00, 0x00, 0x00, 0xff, 0x00, 0x00, 0x00, 0xff, 0x00, 0x00, 0x00, 0xff,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 0xff, 
  0x00, 0xff, 0xff, 0xff, 0x00, 0xff, 0xf9, 0xff, 0x00, 0xfe, 0xf9, 0xff,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 0xff, 
  0x00, 0xfe, 0xf9, 0xff, 0x00, 0xff, 0xf9, 0xff, 0x00, 0xff, 0xf9, 0xff,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 0xff, 
  0x00, 0xff, 0xf9, 0xff, 0x00, 0xff, 0xf9, 0xff, 0x00, 0xff, 0xf9, 0xff,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 0xff, 
  0x00, 0xff, 0xf9, 0xff, 0x00, 0xff, 0xf9, 0xff, 0x00, 0xff, 0xf9, 0xff,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 0xff, 
  0x00, 0xff, 0xf9, 0xff, 0x00, 0xfe, 0xf9, 0xff, 0x00, 0xff, 0xf9, 0xff,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 0xff, 
  0x00, 0xff, 0xff, 0xff, 0x00, 0x00, 0x00, 0xff, 0x00, 0x00, 0x00, 0xff,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 0xff, 
  0x00, 0x00, 0x00, 0xff, 0x00, 0x00, 0x00, 0xff, 0x00, 0x00, 0x00, 0xff,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 0xff, 
  0x00, 0x00, 0x00, 0xff, 0x00, 0x00, 0x00, 0xff, 0x00, 0x00, 0x00, 0xff,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 0xff, 
  0x00, 0x00, 0x00, 0xff, 0x00, 0x00, 0x00, 0xff, 0x00, 0x00, 0x00, 0xff,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 0xff, 
  0x00, 0x00, 0x00, 0xff, 0x00, 0x00, 0x00, 0xff, 0x00, 0x00, 0x00, 0xff,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 0xff, 
  0x00, 0x00, 0x00, 0xff, 0x00, 0x00, 0x00, 0xff, 0x00, 0x00, 0x00, 0xff,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 0xff, 
  0x00, 0x00, 0x00, 0xff, 0x00, 0x00, 0x00, 0xff, 0x00, 0x00, 0x00, 0xff,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 0xff, 
  0x00, 0x00, 0x00, 0xff, 0x00, 0x00, 0x00, 0xff, 0x00, 0x00, 0x00, 0xff,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 0xff, 
  0x00, 0x00, 0x00, 0xff, 0x00, 0x00, 0x00, 0xff, 0x00, 0x00, 0x00, 0xff,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 0xff, 
  0x00, 0x00, 0x00, 0xff, 0x00, 0x00, 0x00, 0xff, 0x00, 0x00, 0x00, 0xff,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 0xff, 
  0x00, 0x00, 0x00, 0xff, 0x00, 0x00, 0x00, 0xff, 0x00, 0x00, 0x00, 0xff,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 0xff, 
  0x00, 0x00, 0x00, 0xff, 0x00, 0x00, 0x00, 0xff, 0x00, 0x00, 0x00, 0xff,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 0xff, 
  0x00, 0x00, 0x00, 0xff, 0x00, 0x00, 0x00, 0xff, 0x00, 0x00, 0x00, 0xff,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 0xff, 
  0x00, 0x00, 0x00, 0xff, 0x00, 0x00, 0x00, 0xff, 0x00, 0x00, 0x00, 0xff,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 0xff, 
  0x00, 0x00, 0x00, 0xff, 0x00, 0x00, 0x00, 0xff, 0x00, 0x00, 0x00, 0xff,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 0xff, 
  0x00, 0x00, 0x00, 0xff, 0x00, 0x00, 0x00, 0xff, 0x00, 0x00, 0x00, 0xff,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 0xff, 
  0x00, 0x00, 0x00, 0xff, 0x00, 0x00, 0x00, 0xff, 0x00, 0x00, 0x00, 0xff,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 0xff, 
  0x00, 0x00, 0x00, 0xff, 0x00, 0x00, 0x00, 0xff, 0x00, 0x00, 0x00, 0xff,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 0xff, 
  0x00, 0x00, 0x00, 0xff, 0x00, 0x00, 0x00, 0xff, 0x00, 0x00, 0x00, 0xff,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 0xff, 
  0x00, 0x00, 0x00, 0xff, 0x00, 0x00, 0x00, 0xff, 0x00, 0x00, 0x00, 0xff,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 0xff, 
  0x00, 0x00, 0x00, 0xff, 0x00, 0x00, 0x00, 0xff, 0x00, 0x00, 0x00, 0xff,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 0xff, 
  0x00, 0x00, 0x00, 0xff, 0x00, 0x00, 0x00, 0xff, 0x00, 0x00, 0x00, 0xff,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 0xff, 
};







hw_timer_t * timer = NULL;
portMUX_TYPE timerMux = portMUX_INITIALIZER_UNLOCKED;


TaskHandle_t Task1;
TaskHandle_t Task2;



// Pins for LED MATRIX

#define matrix_width 128
#define matrix_height 32

// This defines the 'on' time of the display is us. The larger this number,
// the brighter the display. If too large the ESP will crash
uint8_t display_draw_time=10; //10-50 is usually fine

// PxMATRIX display(matrix_width,matrix_height,P_LAT, P_OE,P_A,P_B,P_C);
PxMATRIX display(128,32,P_LAT, P_OE,P_A,P_B,P_C,P_D);






void draw_888_face_con(int x, int y, const uint8_t ani[])   // this draws the face, x and y is an offset
{
 int imageHeight = 32;
 int imageWidth = 64;
 int counter = 0;
 for (int yy = 0; yy < imageHeight; yy++)
 {
   for (int xx = 0; xx < imageWidth; xx++)
   {
 
   display.drawPixelRGB888(xx+x,yy+y,ani[counter],ani[counter+1],ani[counter+2]);

     counter=counter+3;
   }
 }
 imageHeight = 32;
  imageWidth = 64;
  counter = 0;
 for (int yy = 0; yy < imageHeight; yy++)
 {
   for (int xx = 63; xx > -1; xx--)
   {

   display.drawPixelRGB888(xx+64,yy+y,ani[counter],ani[counter+1],ani[counter+2]);

     counter=counter+3;
   }
 }


}

uint16_t myRED = display.color565(255, 0, 0);
uint16_t myGREEN = display.color565(0, 255, 0);
uint16_t myBLUE = display.color565(0, 0, 255);
uint16_t myWHITE = display.color565(255, 255, 255);
uint16_t myYELLOW = display.color565(255, 255, 0);
uint16_t myCYAN = display.color565(0, 255, 255);
uint16_t myMAGENTA = display.color565(255, 0, 255);
uint16_t myBLACK = display.color565(0, 0, 0);

uint16_t myCOLORS[8]={myRED,myGREEN,myBLUE,myWHITE,myYELLOW,myCYAN,myMAGENTA,myBLACK};

void setup() {
 xTaskCreatePinnedToCore(
                    Task2code,   // Task function. 
                    "Task2",     // name of task. 
                    11000,        //Stack size of task 
                    NULL,        // parameter of the task 
                    24,           // priority of the task 
                    &Task2,      // Task handle to keep track of created task 
                    0);          // pin task to core 1  


  display.begin(16);
  display.setPanelsWidth(2);

  display.setFastUpdate(false);
  display.clearDisplay();
  draw_888_face_con(0,0,owo);
}

void Task2code( void * pvParameters ){   //Evil second core trickery
 
  for(;;){
  delay(1); 
  display.display(50); //was60  

  }
}


void loop() {
      draw_888_face_con(0,0,owo);
 
  }
